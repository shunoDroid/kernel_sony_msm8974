## arch/arm/configs/shunodroid_defconfig
```kconfig
# TCP
CONFIG_TCP_CONG_ADVANCED=y
CONFIG_TCP_CONG_WESTWOOD=y

# CPU and GPU
CONFIG_ADRENO_IDLER=y
CONFIG_CPU_VOLTAGE_TABLE=y
CONFIG_TURBO_BOOST=y
```
